## conf/layer.conf
```bitbake
# We have a conf and classes directory, add to BBPATH
BBPATH .= ":${LAYERDIR}"

# We have recipes-* directories, add to BBFILES
BBFILES += "${LAYERDIR}/recipes-core/staging-ipk-pkgs.bb"

BBFILE_COLLECTIONS += "stack-layering-support"
BBFILE_PATTERN_stack-layering-support = "^${LAYERDIR}/"
BBFILE_PRIORITY_stack-layering-support = "6"

LAYERDEPENDS_stack-layering-support = "core"
LAYERSERIES_COMPAT_stack-layering-support = "dunfell kirkstone"

require include/pkg-resolver.conf
```
